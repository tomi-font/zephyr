## sample.yaml
```
sample:
  name: PSA persistent key sample
  description: Demonstration of persistent key usage with PSA Crypto API.
common:
  tags:
    - psa
  timeout: 10
  harness: console
  harness_config:
    type: one_line
    regex:
      - "Sample finished successfully."
tests:
  sample.psa.persistent_key.secure_storage.entropy_driver:
    filter: not CONFIG_BUILD_WITH_TFM and CONFIG_ENTROPY_HAS_DRIVER
    integration_platforms: &secure_storage_integration_platforms
      - native_sim
      - nrf52840dk/nrf52840
    extra_args: EXTRA_CONF_FILE=overlay-secure_storage.conf;overlay-entropy_driver.conf
    tags:
      - drivers.entropy
      - settings
  sample.psa.persistent_key.secure_storage.entropy_not_secure:
    filter: not CONFIG_BUILD_WITH_TFM and not CONFIG_ENTROPY_HAS_DRIVER
    integration_platforms: *secure_storage_integration_platforms
    extra_args: EXTRA_CONF_FILE="overlay-secure_storage.conf"
    extra_configs:
      - CONFIG_TEST_RANDOM_GENERATOR=y
      - CONFIG_TIMER_RANDOM_GENERATOR=y
      - CONFIG_MBEDTLS_ZEPHYR_ENTROPY=y
    tags:
      - random
      - settings
  sample.psa.persistent_key.tfm:
    filter: CONFIG_BUILD_WITH_TFM
    integration_platforms:
      - nrf9160dk/nrf9160/ns
    tags:
      - trusted-firmware-m
```

## prj.conf
```kconfig
# Copyright (c) 2024 Nordic Semiconductor ASA
# SPDX-License-Identifier: Apache-2.0

CONFIG_LOG=y

# The default stack size (1024) is not enough
# for platforms with a local PSA Crypto core.
CONFIG_MAIN_STACK_SIZE=4096

CONFIG_PSA_WANT_KEY_TYPE_AES=y
CONFIG_PSA_WANT_ALG_CTR=y
```

## boards/nrf9160dk_nrf9160.conf
```kconfig
#
# Copyright (c) 2024 Nordic Semiconductor ASA
#
# SPDX-License-Identifier: LicenseRef-Nordic-5-Clause

CONFIG_MBEDTLS=y
CONFIG_MBEDTLS_PSA_CRYPTO_C=y

# PSA Crypto core requires an entropy source.
# nRF91's CryptoCell is not supported in vanilla Zephyr,
# so use an entropy source that's available. Not secure!
CONFIG_TEST_RANDOM_GENERATOR=y
CONFIG_TIMER_RANDOM_GENERATOR=y
CONFIG_MBEDTLS_ZEPHYR_ENTROPY=y

# Default stack size (1024) is not enough for psa_crypto_init().
CONFIG_MAIN_STACK_SIZE=4096

CONFIG_TRUSTED_STORAGE=y
```

## src/main.c
```c
/* SPDX-License-Identifier: Apache-2.0 */

#include <psa/crypto.h>
#include <zephyr/logging/log.h>

LOG_MODULE_REGISTER(persistent_key);

#define SAMPLE_KEY_ID   PSA_KEY_ID_USER_MIN
#define SAMPLE_KEY_TYPE PSA_KEY_TYPE_AES
#define SAMPLE_ALG      PSA_ALG_CTR
#define SAMPLE_KEY_BITS 256

int generate_persistent_key(void)
{
	LOG_INF("Generating a persistent key...");
	psa_status_t ret;
	psa_key_id_t key_id;
	psa_key_attributes_t key_attributes = PSA_KEY_ATTRIBUTES_INIT;

	psa_set_key_lifetime(&key_attributes, PSA_KEY_LIFETIME_PERSISTENT);
	psa_set_key_usage_flags(&key_attributes, PSA_KEY_USAGE_ENCRYPT | PSA_KEY_USAGE_DECRYPT);
	psa_set_key_id(&key_attributes, SAMPLE_KEY_ID);
	psa_set_key_type(&key_attributes, SAMPLE_KEY_TYPE);
	psa_set_key_algorithm(&key_attributes, SAMPLE_ALG);
	psa_set_key_bits(&key_attributes, SAMPLE_KEY_BITS);

	ret = psa_generate_key(&key_attributes, &key_id);
	if (ret != PSA_SUCCESS) {
		LOG_ERR("Failed to generate the key. (%d)", ret);
		return -1;
	}
	__ASSERT_NO_MSG(key_id == SAMPLE_KEY_ID);

	/* Purge the key from volatile memory. Has the same affect than resetting the device. */
	ret = psa_purge_key(SAMPLE_KEY_ID);
	if (ret != PSA_SUCCESS) {
		LOG_ERR("Failed to purge the generated key. (%d).", ret);
		return -1;
	}

	LOG_INF("Persistent key generated.");
	return 0;
}

int use_persistent_key(void)
{
	LOG_INF("Using the persistent key to encrypt and decrypt some plaintext...");
	psa_status_t ret;
	uint32_t ciphertext_len;
	uint32_t decrypted_text_len;

	static uint8_t plaintext[100] =
		"Example plaintext to demonstrate basic usage of a persistent key.";
	static uint8_t ciphertext[PSA_CIPHER_ENCRYPT_OUTPUT_SIZE(SAMPLE_KEY_TYPE, SAMPLE_ALG,
								 sizeof(plaintext))];
	static uint8_t decrypted_text[sizeof(plaintext)];

	ret = psa_cipher_encrypt(SAMPLE_KEY_ID, SAMPLE_ALG, plaintext, sizeof(plaintext),
				 ciphertext, sizeof(ciphertext), &ciphertext_len);
	if (ret != PSA_SUCCESS) {
		LOG_ERR("Failed to encrypt the plaintext. (%d)", ret);
		return -1;
	}

	ret = psa_cipher_decrypt(SAMPLE_KEY_ID, SAMPLE_ALG, ciphertext, ciphertext_len,
				 decrypted_text, sizeof(decrypted_text), &decrypted_text_len);
	if (ret != PSA_SUCCESS) {
		LOG_ERR("Failed to decrypt the ciphertext. (%d)", ret);
		return -1;
	}
	__ASSERT_NO_MSG(decrypted_text_len == sizeof(plaintext));

	/* Check that the decryption gives us the original plaintext back. */
	if (memcmp(plaintext, decrypted_text, sizeof(plaintext))) {
		LOG_HEXDUMP_INF(plaintext, sizeof(plaintext), "Plaintext:");
		LOG_HEXDUMP_INF(ciphertext, ciphertext_len, "Ciphertext:");
		LOG_HEXDUMP_INF(decrypted_text, sizeof(decrypted_text), "Decrypted plaintext:");
		LOG_ERR("The decrypted text doesn't match the plaintext.");
		return -1;
	}

	LOG_INF("Persistent key usage successful.");
	return 0;
}

static int destroy_persistent_key(void)
{
	LOG_INF("Destroying the persistent key...");
	psa_status_t ret;

	ret = psa_destroy_key(SAMPLE_KEY_ID);
	if (ret != PSA_SUCCESS) {
		LOG_ERR("Failed to destroy the key. (%d)", ret);
		return -1;
	}

	ret = psa_destroy_key(SAMPLE_KEY_ID);
	if (ret != PSA_ERROR_INVALID_HANDLE) {
		LOG_ERR("Unexpected psa_destroy_key() return value when"
			" destroying the key a second time. (%d)", ret);
		return -1;
	}

	LOG_INF("Persistent key destroyed.");
	return 0;
}

int main(void)
{
	LOG_INF("Persistent key sample started.");

	/* Ensure there is not already a key with this ID. */
	psa_destroy_key(SAMPLE_KEY_ID);

	if (generate_persistent_key()) {
		return -1;
	}

	if (use_persistent_key()) {
		return -1;
	}

	if (destroy_persistent_key()) {
		return -1;
	}

	LOG_INF("Sample finished successfully.");
	return 0;
}
```
