## sample.yaml
```
sample:
  name: PSA ITS sample
  description: Example of PSA Internal Trusted Storage (ITS) API usage.
common:
  tags:
    - psa
  timeout: 10
  harness: console
  harness_config:
    type: one_line
    regex:
      - "Sample finished successfully."
tests:
  sample.psa.its.secure_storage.entropy_driver:
    filter: not CONFIG_BUILD_WITH_TFM and CONFIG_ENTROPY_HAS_DRIVER
    integration_platforms: &secure_storage_integration_platforms
      - native_sim
      - nrf52840dk/nrf52840
    extra_args: EXTRA_CONF_FILE=overlay-secure_storage.conf;overlay-entropy_driver.conf
    tags:
      - drivers.entropy
      - settings
  sample.psa.its.secure_storage.entropy_not_secure:
    filter: not CONFIG_BUILD_WITH_TFM and not CONFIG_ENTROPY_HAS_DRIVER
    integration_platforms: *secure_storage_integration_platforms
    extra_args: EXTRA_CONF_FILE="overlay-secure_storage.conf"
    extra_configs:
      - CONFIG_TEST_RANDOM_GENERATOR=y
      - CONFIG_TIMER_RANDOM_GENERATOR=y
      - CONFIG_MBEDTLS_ZEPHYR_ENTROPY=y
    tags:
      - random
      - settings
  sample.psa.its.tfm:
    filter: CONFIG_BUILD_WITH_TFM
    integration_platforms:
      - nrf9160dk/nrf9160/ns
    tags:
      - trusted-firmware-m
```

## prj.conf
```kconfig
# Copyright (c) 2024 Nordic Semiconductor ASA
# SPDX-License-Identifier: Apache-2.0

CONFIG_LOG=y
```

## overlay-secure_storage.conf
```kconfig
# SPDX-License-Identifier: Apache-2.0

CONFIG_MBEDTLS=y
CONFIG_MBEDTLS_PSA_CRYPTO_C=y

# The default stack size (1024) is not enough for the PSA Crypto core.
CONFIG_MAIN_STACK_SIZE=4096

CONFIG_TRUSTED_STORAGE=y
```

## boards/nrf52840dk_nrf52840.conf
```kconfig
#
# Copyright (c) 2024 Nordic Semiconductor ASA
#
# SPDX-License-Identifier: LicenseRef-Nordic-5-Clause
#

CONFIG_MBEDTLS=y
CONFIG_MBEDTLS_PSA_CRYPTO_C=y

CONFIG_ENTROPY_GENERATOR=y
CONFIG_MBEDTLS_PSA_CRYPTO_EXTERNAL_RNG=y

CONFIG_TRUSTED_STORAGE=y
```

## boards/nrf9160dk_nrf9160.conf
```kconfig
#
# Copyright (c) 2024 Nordic Semiconductor ASA
#
# SPDX-License-Identifier: LicenseRef-Nordic-5-Clause

CONFIG_MBEDTLS=y
CONFIG_MBEDTLS_PSA_CRYPTO_C=y

# PSA Crypto core requires an entropy source.
# nRF91's CryptoCell is not supported in vanilla Zephyr,
# so use an entropy source that's available. Not secure!
CONFIG_TEST_RANDOM_GENERATOR=y
CONFIG_TIMER_RANDOM_GENERATOR=y
CONFIG_MBEDTLS_ZEPHYR_ENTROPY=y

CONFIG_TRUSTED_STORAGE=y
```

## src/main.c
```c
/* SPDX-License-Identifier: Apache-2.0 */

#include <psa/crypto.h>
#include <psa/internal_trusted_storage.h>
#include <zephyr/logging/log.h>

LOG_MODULE_REGISTER(psa_its);

#define SAMPLE_DATA_UID (psa_storage_uid_t)1

static int read_inexistent_uid(void)
{
	LOG_INF("Verifying that reading an inexistent UID will fail...");
	psa_status_t ret;

	/* Read from the start of the entry. */
	const uint32_t data_offset = 0;

	/* The buffer to which the data read is written. */
	uint8_t p_data[4];

	/* Number of bytes written. */
	size_t p_data_length;

	ret = psa_its_get(SAMPLE_DATA_UID, data_offset, sizeof(p_data), p_data, &p_data_length);
	if (ret != PSA_ERROR_DOES_NOT_EXIST) {
		LOG_ERR("Unexpected psa_its_get() return value. (%d)", ret);
		return -1;
	}

	LOG_INF("Attempting to read an inexistent UID correctly failed.");
	return 0;
}

static int write_and_read_data(void)
{
	LOG_INF("Writing to and reading back from ITS...");
	psa_status_t ret;

	/* Data to be written to ITS. */
	uint8_t p_data_write[16];

	/* Storage flags for the entry. */
	const psa_storage_create_flags_t create_flags = PSA_STORAGE_FLAG_NONE;

	memset(p_data_write, 0x42, sizeof(p_data_write));

	ret = psa_its_set(SAMPLE_DATA_UID, sizeof(p_data_write), p_data_write, create_flags);
	if (ret != PSA_SUCCESS) {
		LOG_ERR("Writing the data to ITS failed. (%d)", ret);
		return -1;
	}

	/* Data to be read from ITS. */
	uint8_t p_data_read[sizeof(p_data_write)];

	/* Read from the start of the entry. */
	uint32_t data_offset = 0;

	/* Number of bytes read. */
	size_t p_data_length = 0;

	ret = psa_its_get(SAMPLE_DATA_UID, data_offset, sizeof(p_data_read), p_data_read,
			  &p_data_length);
	if (ret != PSA_SUCCESS) {
		LOG_ERR("Reading back the data from ITS failed. (%d).", ret);
		return -1;
	}

	if (p_data_length != sizeof(p_data_read)) {
		LOG_ERR("Unexpected amount of bytes read back. (%zu != %zu)",
			p_data_length, sizeof(p_data_read));
		return -1;
	}

	if (memcmp(p_data_write, p_data_read, sizeof(p_data_read))) {
		LOG_HEXDUMP_ERR(p_data_read, sizeof(p_data_read), "Wrong data read back:");
		return -1;
	}

	LOG_INF("Successfully wrote to ITS and read back what was written.");
	return 0;
}

static int remove_entry(void)
{
	LOG_INF("Removing the entry from ITS...");
	psa_status_t ret;

	ret = psa_its_remove(SAMPLE_DATA_UID);
	if (ret != PSA_SUCCESS) {
		LOG_ERR("Failed to remove the entry. (%d)", ret);
		return -1;
	}

	LOG_INF("Entry removed from ITS.");
	return 0;
}

int main(void)
{
	LOG_INF("PSA ITS sample started.");

	/* Ensure there is not already an entry with this UID. */
	psa_its_remove(SAMPLE_DATA_UID);

	if (read_inexistent_uid()) {
		return -1;
	}

	if (write_and_read_data()) {
		return -1;
	}

	if (remove_entry()) {
		return -1;
	}

	LOG_INF("Sample finished successfully.");
	return 0;
}
```
