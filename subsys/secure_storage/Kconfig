## subsys/secure_storage/Kconfig
```kconfig
# SPDX-License-Identifier: Apache-2.0

menuconfig SECURE_STORAGE
	bool "Secure storage subsystem"
	depends on !BUILD_WITH_TFM
	select EXPERIMENTAL
	imply MBEDTLS_PSA_CRYPTO_STORAGE_C
	help
	  The secure storage subsystem allows securely storing data via the PSA Secure Storage API
	  on platforms that don't already have an implementation of it.
	  It also provides its implementation of the PSA Internal Trusted Storage (ITS) API to the PSA Crypto API implementation, allowing the use of persistent keys in the PSA Crypto API.
	  It is configurable with different implementations for both the securing and storing of the data to suit the varying capabilities of different platforms.
	  The actual security provided depends on the security features that are available and used
	  on a given platform.

if SECURE_STORAGE

module = SECURE_STORAGE
module-str = secure_storage
source "subsys/logging/Kconfig.template.log_config"

choice SECURE_STORAGE_ITS_IMPLEMENTATION
	prompt "Internal Trusted Storage (ITS) API implementation"

config SECURE_STORAGE_ITS_IMPLEMENTATION_DEFAULT
	bool "Default ITS implementation"
	select SECURE_STORAGE_ITS_SECURING_MODULE
	select SECURE_STORAGE_ITS_STORING_MODULE
	help
	  Use the default implementation of the ITS API.
	  It calls the securing/storing modules, which can be configured
	  and have custom implementations.

config SECURE_STORAGE_ITS_IMPLEMENTATION_CUSTOM
	bool "Custom ITS implementation"
	help
	  A custom implementation of the ITS API is present.
	  The secure_storage_its_impl_*() functions must be implemented.

endchoice # SECURE_STORAGE_ITS_IMPLEMENTATION

config SECURE_STORAGE_PS_IMPLEMENTATION_CUSTOM
	bool "Custom Protected Storage (PS) API implementation"
	help
	  Whether a custom implementation of the PS API is present.
	  If not, the default behavior of directly calling into the ITS API will be enabled.
	  This means that the ITS and the PS will be identical.
	  If providing a custom implementation, implement the secure_storage_ps_impl_*() functions.

if SECURE_STORAGE_ITS_IMPLEMENTATION_DEFAULT

config SECURE_STORAGE_ITS_MAX_DATA_SIZE
	int "Maximum data size of an ITS entry in bytes"
	default 64
	help
	  The maximum size, in bytes, that the data of an ITS entry can be.
	  Increasing this value increases the stack usage when serving PSA ITS API calls.

endif # SECURE_STORAGE_ITS_IMPLEMENTATION_DEFAULT

menuconfig SECURE_STORAGE_ITS_SECURING_MODULE
	bool "ITS securing module"
	help
	  The module that provides encryption and authentication-related functions.
	  It is used by the default ITS API implementation.

if SECURE_STORAGE_ITS_SECURING_MODULE
rsource "Kconfig.its_securing"
endif

menuconfig SECURE_STORAGE_ITS_STORING_MODULE
	bool "ITS securing module"
	help
	  The module that handles storage/retrieval of the data to/from non-volatile memory.
	  It is used by the default ITS API implementation.

if SECURE_STORAGE_ITS_STORING_MODULE
rsource "Kconfig.its_storing"
endif

if SECURE_STORAGE_PS_IMPLEMENTATION_CUSTOM

config SECURE_STORAGE_PS_SUPPORTS_SET_EXTENDED
	bool "PS API implementation supports psa_ps_create() and psa_ps_set_extended()"
	help
	  Whether the psa_ps_create() and psa_ps_set_extended() are implemented.

endif # SECURE_STORAGE_PS_IMPLEMENTATION_CUSTOM

endif # SECURE_STORAGE
```

## subsys/secure_storage/Kconfig.its_securing
```kconfig
# SPDX-License-Identifier: Apache-2.0

choice SECURE_STORAGE_ITS_SECURING_KEY_PROVIDER
	prompt "ITS securing module encryption key provider"

config SECURE_STORAGE_ITS_SECURING_KEY_PROVIDER_DEFAULT
	bool "Default key provider"
	select PSA_WANT_ALG_SHA_256
	imply HWINFO
	help
	  The default key provider returns the SHA-256 hash of the UID of the ITS entry being processed as the key. In addition to the UID, it hashes the following, if available:
	  - the device EUI64 as returned by hwinfo_get_device_eui64(), as first choice;
	  - the device ID as returned by hwinfo_get_device_uuid(), as second choice.
	  If no device ID is available or if the device ID is easily readable, the security of the key provided is low because the UIDs are easily guessable.
	  Implement a more secure key provider if possible.

config SECURE_STORAGE_ITS_SECURING_KEY_PROVIDER_CUSTOM
	bool "Custom key provider"
	help
	  Implement the secure_storage_its_securing_get_key() function.

endchoice # SECURE_STORAGE_ITS_SECURING_KEY_PROVIDER

config SECURE_STORAGE_ITS_SECURING_KEY_SIZE
	int "ITS securing module encryption key size in bytes"
	default 32

choice SECURE_STORAGE_ITS_SECURING_NONCE_PROVIDER
	prompt "ITS securing module nonce provider"

config SECURE_STORAGE_ITS_SECURING_NONCE_PROVIDER_DEFAULT
	bool "Default nonce provider"
	select PSA_WANT_GENERATE_RANDOM
	help
	  The default nonce provider generates a random number for the first nonce with
	  psa_generate_random(), then increments it for every subsequent nonce. A random
	  source that doesn't repeat values between reboots is required for this to be secure.

config SECURE_STORAGE_ITS_SECURING_NONCE_PROVIDER_CUSTOM
	bool "Custom nonce provider"
	help
	  Implement the secure_storage_its_securing_get_nonce() function.

endchoice # SECURE_STORAGE_ITS_SECURING_NONCE_PROVIDER

config SECURE_STORAGE_ITS_SECURING_NONCE_SIZE
	int "ITS securing module nonce size in bytes"
	default 12

choice SECURE_STORAGE_ITS_SECURING_AEAD_SCHEME_PROVIDER
	prompt "ITS securing module AEAD scheme provider"

config SECURE_STORAGE_ITS_SECURING_AEAD_SCHEME_PROVIDER_DEFAULT
	prompt "Default AEAD scheme (AES-GCM)"
	select PSA_WANT_KEY_TYPE_AES
	select PSA_WANT_ALG_GCM
	depends on SECURE_STORAGE_ITS_SECURING_NONCE_SIZE = 12

config SECURE_STORAGE_ITS_SECURING_AEAD_SCHEME_PROVIDER_CUSTOM
	bool "Custom AEAD scheme provider"
	help
	  Implement the secure_storage_its_securing_get_aead_scheme() function.

endchoice # SECURE_STORAGE_ITS_SECURING_AEAD_SCHEME_PROVIDER

config SECURE_STORAGE_ITS_SECURING_AEAD_CRYPT_IMPLEMENTATION_CUSTOM
	bool "Custom AEAD en/decrypt implementation"
	help
	  Implement the secure_storage_its_securing_aead_crypt() function.
```

## subsys/secure_storage/Kconfig.its_storing
```kconfig
# SPDX-License-Identifier: Apache-2.0

choice SECURE_STORAGE_ITS_STORING_IMPLEMENTATION
	prompt "ITS storing module implementation"

config SECURE_STORAGE_ITS_STORING_IMPLEMENTATION_SETTINGS
	bool "ITS storing module implementation using the settings subsystem for storage"
	imply FLASH
	imply FLASH_MAP
	imply NVS
	select SETTINGS

config SECURE_STORAGE_ITS_STORING_IMPLEMENTATION_CUSTOM
	bool "Custom ITS storing module implementation"
	help
	  Implement the secure_storage_its_storing_*() functions.

endchoice # SECURE_STORAGE_ITS_STORING_IMPLEMENTATION

if SECURE_STORAGE_ITS_STORING_IMPLEMENTATION_SETTINGS

config SECURE_STORAGE_ITS_STORING_SETTINGS_PREFIX
	string "Subtree in which to store the settings, with a trailing slash. Can be empty."
	default "its/"

config SECURE_STORAGE_ITS_STORING_SETTINGS_ENCRYPT_UID
	bool "Encrypt the ITS entry UIDs"
	depends on SECURE_STORAGE_ITS_SECURING_MODULE
	default y if SECURE_STORAGE_ITS_SECURING_KEY_PROVIDER_DEFAULT
	select PSA_WANT_KEY_TYPE_AES
	select PSA_WANT_ALG_ECB_NO_PADDING
	help
	  Encrypt the UID of the stored entries with the key provided by the securing module.
	  The entry UIDs are used in the names of the settings that store the data associated with
	  an entry.
	  This should be enabled when the default key provider is in use and no device ID is
	  available (via the HW info API), in which case only the entry UIDs are used to generate
	  keys. This is to avoid storing the entry UIDs in clear, in which case it would be trivial
	  to find them and generate the keys used to encrypt the data.
	  This doesn't provide much security by itself, just some more obfuscation.
	  This is not needed if a more secure key is provided; the authenticity of the entry UIDs
	  is checked by the default ITS implementation, not by this.

endif # SECURE_STORAGE_ITS_STORING_IMPLEMENTATION_SETTINGS
```
